## moistureapp/Kconfig
```kconfig
#
# For a description of the syntax of this configuration file,
# see the file kconfig-language.txt in the NuttX tools repository.
#

config EXAMPLES_MOISTUREAPP
	tristate "\"Moisture App\" example"
	default n
	---help---
		Enable the \"Moisture App\" example

if EXAMPLES_MOISTUREAPP

config EXAMPLES_MOISTUREAPP_PROGNAME
	string "Program name"
	default "moistureapp"
	depends on BUILD_LOADABLE
	---help---
		This is the name of the program that will be use when the NSH ELF
		program is installed.

config EXAMPLES_MOISTUREAPP_PRIORITY
	int "Moisture task priority"
	default 100

config EXAMPLES_MOISTUREAPP_STACKSIZE
	int "Moisture stack size"
	default 2048

endif
```
